## config/west.yml
```yaml
manifest:
  remotes:
    - name: zmkfirmware
      url: https://github.com/zmkfirmware/zmk
    - name: urob
      url: https://github.com/urob
  projects:
    - name: zmk
      remote: zmkfirmware
      revision: main  # Using the main branch is safer for Git fetching
      import: app/west.yml
    - name: zmk-helpers
      remote: urob
      revision: main
  self:
    path: config
```
